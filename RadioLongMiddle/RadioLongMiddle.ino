#include <Arduino.h>
#include <U8g2lib.h>

// EmuCan
#include "EMUcan.h"
EMUcan emucan(0x600); // Base ID 600 --> See EMU settings

#include <mcp2515.h>
struct can_frame canMsg;
MCP2515 mcp2515(10); // CS Pin 10

unsigned long previousMillis = 0;
const long interval = 500;

// NO EMU Display
unsigned long lastReceivedTime = 0; // Timer to track last received message time
const unsigned long requiredInterval = 5000; // 5 seconds interval

const bool demoMode = false;

U8G2_SSD1306_128X32_UNIVISION_1_HW_I2C u8g2(U8G2_R0, /* reset=*/ U8X8_PIN_NONE, /* clock=*/ SCK, /* data=*/ SDA);   // pin remapping with ESP8266 HW I2C

void u8g2_prepare(void) {
  u8g2.setFont(u8g2_font_logisoso20_tr);
  u8g2.setFontRefHeightExtendedText();
  u8g2.setDrawColor(1);
  u8g2.setFontPosTop();
  u8g2.setFontDirection(0);
}

// 'image-Golf 1', 90x32px
const unsigned char epd_bitmap_image_Golf_1 [] PROGMEM = {
	0x00, 0x00, 0x00, 0xf0, 0xff, 0xff, 0x01, 0x00, 0x00, 0x00, 0x00, 0x00, 0x00, 0x00, 0xff, 0xff, 
	0xff, 0xff, 0x1f, 0x00, 0x00, 0x00, 0x00, 0x00, 0x00, 0xc0, 0xff, 0xff, 0xff, 0xff, 0x6f, 0x00, 
	0x00, 0x00, 0x00, 0x00, 0x00, 0xe0, 0x0f, 0x80, 0x03, 0x00, 0xdc, 0x00, 0x00, 0x00, 0x00, 0x00, 
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	0x78, 0x0e, 0x00, 0x00, 0x00, 0xc0, 0x03, 0x00, 0x00, 0x00, 0x00, 0x00, 0xe0, 0x03, 0x00, 0x00
};

int x_position = -90;
int mode = 1;

void draw_golf() {
  u8g2.setBitmapMode(false /* solid */);
  u8g2.drawXBMP(x_position, 0, 90, 32, epd_bitmap_image_Golf_1);
}

void draw(void) {
  draw_golf();
}

void setup(void) {
  u8g2.begin();
  Serial.begin(9600);
  mcp2515.reset();
  mcp2515.setBitrate(CAN_500KBPS, MCP_8MHZ);
  mcp2515.setNormalMode();
  pinMode(7, INPUT_PULLUP);
  pinMode(6, OUTPUT);
  pinMode(5, INPUT_PULLUP);
  u8g2_prepare();
  delay(6000);
}

void displayTemperature(const char* label, int16_t temp, const char* unit) {
    char buffer[20];

    u8g2.setFont(u8g2_font_profont22_mf);
    int labelTempLen = snprintf(buffer, sizeof(buffer), "%s: %d", label, temp);
    u8g2.drawUTF8(0, 8, buffer);

    int pixelWidthPerChar = 12;
    int labelTempWidthPixels = labelTempLen * pixelWidthPerChar;

    u8g2.setFont(u8g2_font_profont17_mf);
    snprintf(buffer, sizeof(buffer), "%s", unit);

    int unitXPos = labelTempWidthPixels;
    u8g2.drawUTF8(unitXPos, 10, buffer);
}

bool toggleValue = false;

void loop(void) {
  u8g2.firstPage();
  while (u8g2.nextPage()) {
    static unsigned long lastToggleDebounceTime = 0;
    static int lastToggleButtonState = HIGH;
    static int toggleButtonState;
    const long toggleDebounceDelay = 50; // 50 ms debounce time

    int toggleReading = digitalRead(5);

    if (toggleReading != lastToggleButtonState) {
      lastToggleDebounceTime = millis();
    }

    if ((millis() - lastToggleDebounceTime) > toggleDebounceDelay) {
      if (toggleReading != toggleButtonState) {
        toggleButtonState = toggleReading;
        if(lastToggleButtonState == 0) {
          toggleValue = !toggleValue;
          digitalWrite(6, !toggleValue);
          Serial.println("Button Toggled");
          Serial.println(digitalRead(6));
        }
      }
    }
    
    lastToggleButtonState = toggleReading;

    if (x_position > 168) { // Once the bitmap moves off the screen
      if (mcp2515.readMessage(&canMsg) == MCP2515::ERROR_OK) {
        emucan.checkEMUcan(canMsg.can_id, canMsg.can_dlc, canMsg.data);
        if (emucan.EMUcan_Status() == EMUcan_RECEIVED_WITHIN_LAST_SECOND) {
          lastReceivedTime = millis();
        }
      }
      static unsigned long lastDebounceTime = 0;
      static int lastButtonState = HIGH;
      static int buttonState;
      const long debounceDelay = 50; // 50 ms debounce time

      int reading = digitalRead(7);

      if (reading != lastButtonState) {
        lastDebounceTime = millis();
      }

      if ((millis() - lastDebounceTime) > debounceDelay) {
        if (reading != buttonState) {
          buttonState = reading;
          if (buttonState == LOW) {
            mode++;
            if(mode == 5) mode = 0;
          }
        }
      }
      
      lastButtonState = reading;

      if (!demoMode) {
        if (millis() - lastReceivedTime < requiredInterval) {
          if (mode == 1) {
            displayTemperature("CLT", emucan.emu_data.CLT, "C");
          } else if (mode == 2) {
            displayTemperature("EGT1", emucan.emu_data.Egt1, "C");
          } else if (mode == 3) {
            displayTemperature("EGT2", emucan.emu_data.Egt2, "C");
          } else if (mode == 4) {
            displayTemperature("MAP", emucan.emu_data.MAP, "kPa");
          }
        } else {
          u8g2.setDrawColor(1);
          char buffer[20];
          snprintf(buffer, sizeof(buffer), "NO EMU");
          
          u8g2.drawUTF8(0, 6, buffer);
        }
      } else {
        if (mode == 1) {
          displayTemperature("CLT", 102, "C");
        } else if (mode == 2) {
          displayTemperature("EGT1", 756, "C");
        } else if (mode == 3) {
          displayTemperature("EGT2", 897, "C");
        } else if (mode == 4) {
          displayTemperature("MAP", 215, "kPa");
        }
      }
    } else {
      draw();
      x_position += 2; // Move the bitmap to the right
      delay(30);
    }
  }
}


/* 
* Links
* IAT
* OIL TEMP
* OIL PRESSURE
* FUEL PRESSURE
* 
* Rechts
* WATER TEMP CLT
* EGT1
* EGT2
* MAP
* 
**/
